## configs/secomx6sbca62_defconfig
```kconfig
CONFIG_ARM=y
CONFIG_ARCH_MX6=y
CONFIG_TARGET_SECOSBCA62=y
CONFIG_SPL=y
CONFIG_SYS_EXTRA_OPTIONS="IMX_CONFIG=arch/arm/imx-common/spl_sd.cfg,MX6QDL"
CONFIG_CMD_GPIO=y
CONFIG_DM=y
CONFIG_DM_THERMAL=y
CONFIG_APX_WATCHDOG=y
CONFIG_SPI_FLASH=y
CONFIG_SPI_FLASH_SPANSION=y
```
